## conf/bblayers.conf.sample
```bitbake
# POKY_BBLAYERS_CONF_VERSION is increased each time build/conf/bblayers.conf
# structure changes
POKY_BBLAYERS_CONF_VERSION = "2"

BBPATH = "${TOPDIR}"
BBFILES ?= ""

#
# Layer paths — adjust ${CO_PILOT_ROOT} to your checkout location
#
CO_PILOT_ROOT ??= "${TOPDIR}/../.."

BBLAYERS ?= " \
    ${CO_PILOT_ROOT}/meta-co-pilot \
    ${CO_PILOT_ROOT}/../poky/meta \
    ${CO_PILOT_ROOT}/../poky/meta-poky \
    ${CO_PILOT_ROOT}/../poky/meta-yocto-bsp \
    ${CO_PILOT_ROOT}/../meta-openembedded/meta-oe \
    ${CO_PILOT_ROOT}/../meta-openembedded/meta-multimedia \
    ${CO_PILOT_ROOT}/../meta-openembedded/meta-networking \
    ${CO_PILOT_ROOT}/../meta-openembedded/meta-python \
    ${CO_PILOT_ROOT}/../meta-openembedded/meta-filesystems \
    ${CO_PILOT_ROOT}/../meta-freescale \
    ${CO_PILOT_ROOT}/../meta-freescale-3rdparty \
    ${CO_PILOT_ROOT}/../meta-rust \
    ${CO_PILOT_ROOT}/../meta-clang \
    ${CO_PILOT_ROOT}/../meta-imx/meta-bsp \
    ${CO_PILOT_ROOT}/../meta-imx/meta-sdk \
    ${CO_PILOT_ROOT}/../meta-rauc \
"
```

## conf/local.conf.sample
```bitbake
#@TYPE: Machine
#@NAME: Sigma Racer Wingman i.MX 8M Plus
#@DESCRIPTION: Sigma motorcycle instrument cluster — i.MX 8M Plus reference

MACHINE ??= "sigmaracer-wingman-imx8mp"
DISTRO ??= "sigmaracer-wingman"

# Source sibling instrumentation crate (default: sigmaracer-wingman/sigmaracer-instrumentation symlink)
SIGMA_INSTRUMENTATION_SRC ??= "${TOPDIR}/../../sigmaracer-instrumentation"

#
# Parallel build
#
BB_NUMBER_THREADS ?= "${@oe.utils.cpu_count()}"
PARALLEL_MAKE ?= "-j ${@oe.utils.cpu_count()}"

#
# Disk space
#
DL_DIR ?= "${TOPDIR}/../downloads"
SSTATE_DIR ?= "${TOPDIR}/../sstate-cache"

#
# Production features — uncomment for release images
#
# DISTRO_FEATURES:append = " rauc read-only-rootfs tpm2"
# EXTRA_IMAGE_FEATURES += " read-only-rootfs"

#
# Accept NXP EULA for i.MX BSP components (required for meta-imx)
#
# EULA accepts must be set per meta-imx documentation:
# ACCEPT_FSL_EULA = "1"

#
# RAUC signing (development — replace for production)
#
# RAUC_KEY_FILE = "${TOPDIR}/../keys/rauc/development-key.pem"
# RAUC_CERT_FILE = "${TOPDIR}/../keys/rauc/development-ca.cert.pem"

#
# SDK for Rust cross-development
#
# TOOLCHAIN_TARGET_TASK:append = " packagegroup-rust-cross-canadian-${MACHINE}"
```

## meta-co-pilot/conf/distro/co-pilot.conf
```bitbake
require conf/distro/poky.conf
require conf/distro/include/co-pilot-wayland.inc
require conf/distro/include/co-pilot-security.inc

DISTRO = "co-pilot"
DISTRO_NAME = "Sigma Co-Pilot Instrument Cluster"
DISTRO_VERSION = "1.0"
DISTRO_CODENAME = "cluster"

MAINTAINER = "Sigma Embedded <embedded@sigma.local>"

TARGET_VENDOR = "-sigma"

# systemd everywhere
INIT_MANAGER = "systemd"
VIRTUAL-RUNTIME_init_manager = "systemd"
VIRTUAL-RUNTIME_initscripts = "systemd-compat-units"
DISTRO_FEATURES:append = " systemd usrmerge"

# Graphics & connectivity baseline
DISTRO_FEATURES:append = " wayland opengl egl gles2 vulkan"
DISTRO_FEATURES:append = " bluetooth wifi nfc pam polkit"
DISTRO_FEATURES:append = " can socketcan"

# Production-oriented features (enable in local.conf for target images)
# DISTRO_FEATURES:append = " rauc read-only-rootfs tpm2"

# Prefer NXP BSP kernel and GPU stack
PREFERRED_PROVIDER_virtual/kernel = "linux-imx"
PREFERRED_PROVIDER_virtual/libgl = "imx-gpu-viv"
PREFERRED_PROVIDER_virtual/egl = "imx-gpu-viv"
PREFERRED_PROVIDER_virtual/libgles2 = "imx-gpu-viv"

# Wayland compositor
PREFERRED_PROVIDER_virtual/weston = "weston"

# Rust toolchain from meta-rust or meta-openembedded
PREFERRED_VERSION_rust = "1.79%"
PREFERRED_VERSION_rust-native = "1.79%"

# Image defaults
IMAGE_FSTYPES ?= "wic.gz wic.bmap ext4.gz"
WKS_FILE ?= "co-pilot-ab.wks.in"

# Read-only root with overlay for /etc and /var when enabled
OVERLAYFS_ETC_USE_ORIG_INIT_FILE = "1"

# OTA / RAUC slot naming
RAUC_SLOT_ROOTFS_A = "rootfs_a"
RAUC_SLOT_ROOTFS_B = "rootfs_b"

# Instrument cluster runs as dedicated user
CO_PILOT_USER = "cluster"
CO_PILOT_GROUP = "cluster"

# Sole UI application (instrumentation / sigma-dash)
CO_PILOT_CLUSTER_APP = "sigma-dash"
CO_PILOT_UI_PACKAGE = "instrumentation"

INHERIT += "uninative"
```

## meta-co-pilot/conf/distro/include/co-pilot-security.inc
```bitbake
# Security, OTA, and read-only root filesystem options

# Enable in production local.conf:
#   DISTRO_FEATURES:append = " rauc read-only-rootfs tpm2"
#
# Secure boot is board-specific (CST / HAB on i.MX) — configure in meta-imx
# and board fuse programming workflow outside this layer.

# RAUC bundle signing key paths (override in local.conf, never commit keys)
# RAUC_KEY_FILE = "${TOPDIR}/../keys/rauc/development-key.pem"
# RAUC_CERT_FILE = "${TOPDIR}/../keys/rauc/development-ca.cert.pem"

# A/B partition labels used by wic and RAUC
CO_PILOT_SLOT_A_LABEL = "rootfs_a"
CO_PILOT_SLOT_B_LABEL = "rootfs_b"
CO_PILOT_BOOT_LABEL = "boot"
```

## meta-co-pilot/conf/distro/include/co-pilot-wayland.inc
```bitbake
# Wayland / Weston kiosk configuration for instrument cluster display

DISTRO_FEATURES:append = " wayland"

# Weston runs on tty7 in kiosk mode; cluster UI is launched via systemd
PACKAGECONFIG:append:pn-weston = " kiosk systemd"

# Slint uses FemtoVG with OpenGL ES on embedded targets
PREFERRED_RPROVIDER_libEGL = "libegl-imx"
PREFERRED_RPROVIDER_libGLESv2 = "libgles-imx"

# Font rendering for Slint UI
IMAGE_INSTALL:append = " \
    fontconfig \
    fontconfig-utils \
    liberation-fonts \
    harfbuzz \
    freetype \
"
```

## meta-co-pilot/conf/layer.conf
```bitbake
# We have a conf and classes directory, add to BBPATH
BBPATH .= ":${LAYERDIR}"

# We have recipes-* directories, add to BBFILES
BBFILES += "${LAYERDIR}/recipes-*/*/*.bb \
            ${LAYERDIR}/recipes-*/*/*.bbappend"

BBFILE_COLLECTIONS += "co-pilot"
BBFILE_PATTERN_co-pilot = "^${LAYERDIR}/"
BBFILE_PRIORITY_co-pilot = "20"

LAYERDEPENDS_co-pilot = "core openembedded-layer"
# meta-imx, meta-freescale, meta-rust, meta-rauc added via bblayers.conf.sample
LAYERSERIES_COMPAT_co-pilot = "scarthgap"

# Instrumentation UI — sole application (co-pilot/instrumentation → ../instrumentation)
CO_PILOT_ROOT ??= "${LAYERDIR}/../.."
SIGMA_INSTRUMENTATION_SRC ??= "${CO_PILOT_ROOT}/instrumentation"

LICENSE_PATH += "${LAYERDIR}/licenses"
```

## meta-co-pilot/conf/machine/co-pilot-imx8mp.conf
```bitbake
# Sigma Co-Pilot — NXP i.MX 8M Plus reference platform
# Requires: meta-imx, meta-freescale, imx8mp-lpddr4-evk machine support

require conf/machine/imx8mp-lpddr4-evk.conf

MACHINE = "co-pilot-imx8mp"
MACHINEOVERRIDES =. "co-pilot:imx8mpevk:"

MACHINE_FEATURES:append = " wifi bluetooth can"

# 800×480 or 1280×720 cluster panel — adjust per hardware
CO_PILOT_DISPLAY_WIDTH = "800"
CO_PILOT_DISPLAY_HEIGHT = "480"

# CAN interface for vehicle bus (SocketCAN)
CO_PILOT_CAN_IFACE = "can0"

# Boot partition size for A/B kernel + dtb artifacts
CO_PILOT_BOOT_PART_SIZE = "128M"

# GPU memory split for 60 FPS Slint UI
IMX_GPU_MEM_SIZE ?= "512"

WKS_FILE = "co-pilot-ab.wks.in"
```

## meta-co-pilot/conf/machine/co-pilot-imx95.conf
```bitbake
# Sigma Co-Pilot — NXP i.MX 95 class platform
# Requires: meta-imx with i.MX 95 BSP support (layer revision dependent)

# When meta-imx provides imx95 machine config, inherit it:
# require conf/machine/imx95-19x19-lpddr4x-evk.conf

MACHINE = "co-pilot-imx95"
MACHINEOVERRIDES =. "co-pilot:imx95:"

MACHINE_FEATURES:append = " wifi bluetooth can vulkan"

CO_PILOT_DISPLAY_WIDTH = "1280"
CO_PILOT_DISPLAY_HEIGHT = "720"
CO_PILOT_CAN_IFACE = "can0"
CO_PILOT_BOOT_PART_SIZE = "128M"

WKS_FILE = "co-pilot-ab.wks.in"

# Placeholder until imx95 machine is available in your meta-imx checkout:
# Uncomment and adjust when BSP is integrated:
# require conf/machine/imx95-19x19-lpddr4x-evk.conf
```

## meta-co-pilot/conf/machine/co-pilot-qemu.conf
```bitbake
# Sigma Co-Pilot — QEMU x86-64 virtual target for local integration testing
# Same 800×480 cluster layout as co-pilot-imx8mp; no NXP BSP required.

require conf/machine/qemux86-64.conf

MACHINE = "co-pilot-qemu"
# Use "virt" not "qemu" — PN "qemu" in OVERRIDES triggers fatal pkgvarcheck QA errors.
MACHINEOVERRIDES =. "co-pilot:virt:"

MACHINE_FEATURES:append = " wifi"

CO_PILOT_DISPLAY_WIDTH = "800"
CO_PILOT_DISPLAY_HEIGHT = "480"

PREFERRED_PROVIDER_virtual/kernel = "linux-yocto"

# ext4 rootfs for runqemu (skip A/B WIC layout used on hardware)
WKS_FILE = ""
IMAGE_FSTYPES:pn-co-pilot-image = "ext4"

# No hardware video codecs on the virtual target
IMAGE_FEATURES:remove = " hwcodec"

# QEMU window matches the cluster panel (800×480)
QB_MEM = "-m 4096"
QB_SMP = "-smp 4"
QB_GRAPHICAL = "-display gtk,window-size=800x480 -device virtio-gpu-pci"
```

## meta-sigma-racer-wingman/conf/layer.conf
```bitbake
# We have a conf and classes directory, add to BBPATH
BBPATH .= ":${LAYERDIR}"

# We have recipes-* directories, add to BBFILES
BBFILES += "${LAYERDIR}/recipes-*/*/*.bb \
            ${LAYERDIR}/recipes-*/*/*.bbappend"

BBFILE_COLLECTIONS += "sigma-racer-wingman"
BBFILE_PATTERN_sigma-racer-wingman = "^${LAYERDIR}/"
BBFILE_PRIORITY_sigma-racer-wingman = "20"

LAYERDEPENDS_sigma-racer-wingman = "core openembedded-layer"
# meta-imx, meta-freescale, meta-rust, meta-rauc added via bblayers.conf.sample
LAYERSERIES_COMPAT_sigma-racer-wingman = "scarthgap"

# Instrumentation UI — sibling repos (sigma-racer-wingman/sigma-instrumentation, sigma-racer → ../sigma-instrumentation, ../sigma-racer)
SIGMA_RACER_WINGMAN_ROOT ??= "${LAYERDIR}/../.."
SIGMA_INSTRUMENTATION_SRC ??= "${SIGMA_RACER_WINGMAN_ROOT}/sigma-instrumentation"
SIGMA_RACER_SRC ??= "${SIGMA_RACER_WINGMAN_ROOT}/sigma-racer"

LICENSE_PATH += "${LAYERDIR}/licenses"
```

## meta-sigma-racer-wingman/conf/machine/sigma-racer-wingman-imx8mp.conf
```bitbake
# Sigma Sigma Racer Wingman — NXP i.MX 8M Plus reference platform
# Requires: meta-imx, meta-freescale, imx8mp-lpddr4-evk machine support

require conf/machine/imx8mp-lpddr4-evk.conf

MACHINE = "sigma-racer-wingman-imx8mp"
MACHINEOVERRIDES =. "sigma-racer-wingman:imx8mpevk:"

MACHINE_FEATURES:append = " wifi bluetooth can"

# 800×480 or 1280×720 cluster panel — adjust per hardware
SIGMA_RACER_WINGMAN_DISPLAY_WIDTH = "800"
SIGMA_RACER_WINGMAN_DISPLAY_HEIGHT = "480"

# CAN interface for Linux infotainment bus (FLEXCAN2 — FLEXCAN1 is M7 safety).
SIGMA_RACER_WINGMAN_CAN_IFACE = "can1"

# Boot partition size for A/B kernel + dtb artifacts
SIGMA_RACER_WINGMAN_BOOT_PART_SIZE = "128M"

# GPU memory split for 60 FPS Slint UI
IMX_GPU_MEM_SIZE ?= "512"

# M7 safety-core firmware (remoteproc). QEMU virt keeps the packagegroup
# default (0) — no Cortex-M7 there.
INCLUDE_SIDEARM_FIRMWARE = "1"

# Build base + overlay devicetrees with a __symbols__ node so U-Boot's
# `fdt apply` can resolve the HMP overlay's &mu / &clk / &flexcan1 targets.
# Without symbols the overlay fails to apply and the M7 never comes up.
KERNEL_DTC_FLAGS += "-@"

WKS_FILE = "sigma-racer-wingman-ab.wks.in"

# RAUC A/B: slot-selecting boot script in the boot FAT (loaded as bsp_script).
IMAGE_BOOT_FILES:append = " boot.scr"
# Cortex-M7 remoteproc overlay (built + deployed by linux-imx_%.bbappend under
# sigma-racer-wingman-overlays/) must ride in the boot FAT so boot.cmd can
# `fdt apply` it before booti.
IMAGE_BOOT_FILES:append = " sigma-racer-wingman-overlays/sigma-racer-wingman-hmp.dtbo;sigma-racer-wingman-hmp.dtbo"
EXTRA_IMAGEDEPENDS:append = " sigma-racer-wingman-boot-script"
```

## meta-sigma-racer-wingman/conf/machine/sigma-racer-wingman-imx95.conf
```bitbake
# Sigma Sigma Racer Wingman — NXP i.MX 95 class platform
# Requires: meta-imx with i.MX 95 BSP support (layer revision dependent)

# When meta-imx provides imx95 machine config, inherit it:
# require conf/machine/imx95-19x19-lpddr4x-evk.conf

MACHINE = "sigma-racer-wingman-imx95"
MACHINEOVERRIDES =. "sigma-racer-wingman:imx95:"

MACHINE_FEATURES:append = " wifi bluetooth can vulkan"

SIGMA_RACER_WINGMAN_DISPLAY_WIDTH = "1280"
SIGMA_RACER_WINGMAN_DISPLAY_HEIGHT = "720"
SIGMA_RACER_WINGMAN_CAN_IFACE = "can0"
SIGMA_RACER_WINGMAN_BOOT_PART_SIZE = "128M"

WKS_FILE = "sigma-racer-wingman-ab.wks.in"

# Placeholder until imx95 machine is available in your meta-imx checkout:
# Uncomment and adjust when BSP is integrated:
# require conf/machine/imx95-19x19-lpddr4x-evk.conf

# Guard: without the meta-imx base machine include above, this MACHINE has no
# SoC tune/kernel/bootloader definition and would build a silently-broken image.
# Fail loudly until the BSP is integrated (the base require sets SOC_FAMILY).
python () {
    if not d.getVar('SOC_FAMILY'):
        bb.fatal(
            "sigma-racer-wingman-imx95 has no i.MX95 BSP wired in yet: uncomment the "
            "'require conf/machine/imx95-19x19-lpddr4x-evk.conf' line in "
            "conf/machine/sigma-racer-wingman-imx95.conf and add meta-imx with i.MX95 "
            "support before building this MACHINE."
        )
}
```

## meta-sigma-racer-wingman/conf/machine/sigma-racer-wingman-qemu.conf
```bitbake
# Sigma Sigma Racer Wingman — QEMU x86-64 virtual target for local integration testing
# Same 800×480 cluster layout as sigma-racer-wingman-imx8mp; no NXP BSP required.

require conf/machine/qemux86-64.conf

MACHINE = "sigma-racer-wingman-qemu"
# Inherit qemux86-64 kernel/features; custom MACHINE name needs explicit KMACHINE.
MACHINEOVERRIDES =. "qemux86-64:sigma-racer-wingman:virt:"
KMACHINE = "qemux86-64"

MACHINE_FEATURES:append = " wifi can"

SIGMA_RACER_WINGMAN_DISPLAY_WIDTH = "800"
SIGMA_RACER_WINGMAN_DISPLAY_HEIGHT = "480"

# Virtual CAN for QEMU integration testing
SIGMA_RACER_WINGMAN_CAN_IFACE = "vcan0"

PREFERRED_PROVIDER_virtual/kernel = "linux-yocto"

# ext4 rootfs for runqemu (skip A/B WIC layout used on hardware)
WKS_FILE = ""
IMAGE_FSTYPES:pn-sigma-racer-wingman-image = "ext4"

# No hardware video codecs on the virtual target
IMAGE_FEATURES:remove = " hwcodecs"

# QEMU: virtio-gpu for Weston DRM (runqemu reads QB_GRAPHICS, not QB_GRAPHICAL)
QB_MEM = "-m 4096"
QB_SMP = "-smp 4"
QB_GRAPHICS = "-device virtio-gpu-pci"
```

## meta-sigmaracer-wingman/conf/distro/include/sigmaracer-wingman-security.inc
```bitbake
# Security, OTA, and read-only root filesystem options

# Enable in production local.conf:
#   DISTRO_FEATURES:append = " rauc read-only-rootfs tpm2"
#
# Secure boot is board-specific (CST / HAB on i.MX) — configure in meta-imx
# and board fuse programming workflow outside this layer.

# RAUC bundle signing key paths (override in local.conf, never commit keys)
# RAUC_KEY_FILE = "${TOPDIR}/../keys/rauc/development-key.pem"
# RAUC_CERT_FILE = "${TOPDIR}/../keys/rauc/development-ca.cert.pem"

# A/B partition labels used by wic and RAUC
SIGMARACER_WINGMAN_SLOT_A_LABEL = "rootfs_a"
SIGMARACER_WINGMAN_SLOT_B_LABEL = "rootfs_b"
SIGMARACER_WINGMAN_BOOT_LABEL = "boot"
```

## meta-sigmaracer-wingman/conf/layer.conf
```bitbake
# We have a conf and classes directory, add to BBPATH
BBPATH .= ":${LAYERDIR}"

# We have recipes-* directories, add to BBFILES
BBFILES += "${LAYERDIR}/recipes-*/*/*.bb \
            ${LAYERDIR}/recipes-*/*/*.bbappend"

BBFILE_COLLECTIONS += "sigmaracer-wingman"
BBFILE_PATTERN_sigmaracer-wingman = "^${LAYERDIR}/"
BBFILE_PRIORITY_sigmaracer-wingman = "20"

LAYERDEPENDS_sigmaracer-wingman = "core openembedded-layer"
# meta-imx, meta-freescale, meta-rust, meta-rauc added via bblayers.conf.sample
LAYERSERIES_COMPAT_sigmaracer-wingman = "scarthgap"

# Instrumentation UI — sole application (sigmaracer-wingman/sigmaracer-instrumentation → ../sigmaracer-instrumentation)
SIGMARACER_WINGMAN_ROOT ??= "${LAYERDIR}/../.."
SIGMA_INSTRUMENTATION_SRC ??= "${SIGMARACER_WINGMAN_ROOT}/sigmaracer-instrumentation"

LICENSE_PATH += "${LAYERDIR}/licenses"
```
