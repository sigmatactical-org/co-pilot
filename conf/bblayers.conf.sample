## meta-sigmaracer-wingman/conf/machine/sigmaracer-wingman-imx8mp.conf
```bitbake
# Sigma Sigma Racer Wingman — NXP i.MX 8M Plus reference platform
# Requires: meta-imx, meta-freescale, imx8mp-lpddr4-evk machine support

require conf/machine/imx8mp-lpddr4-evk.conf

MACHINE = "sigmaracer-wingman-imx8mp"
MACHINEOVERRIDES =. "sigmaracer-wingman:imx8mpevk:"

MACHINE_FEATURES:append = " wifi bluetooth can"

# 800×480 or 1280×720 cluster panel — adjust per hardware
SIGMARACER_WINGMAN_DISPLAY_WIDTH = "800"
SIGMARACER_WINGMAN_DISPLAY_HEIGHT = "480"

# CAN interface for vehicle bus (SocketCAN)
SIGMARACER_WINGMAN_CAN_IFACE = "can0"

# Boot partition size for A/B kernel + dtb artifacts
SIGMARACER_WINGMAN_BOOT_PART_SIZE = "128M"

# GPU memory split for 60 FPS Slint UI
IMX_GPU_MEM_SIZE ?= "512"

WKS_FILE = "sigmaracer-wingman-ab.wks.in"
```

## meta-sigmaracer-wingman/conf/machine/sigmaracer-wingman-imx95.conf
```bitbake
# Sigma Sigma Racer Wingman — NXP i.MX 95 class platform
# Requires: meta-imx with i.MX 95 BSP support (layer revision dependent)

# When meta-imx provides imx95 machine config, inherit it:
# require conf/machine/imx95-19x19-lpddr4x-evk.conf

MACHINE = "sigmaracer-wingman-imx95"
MACHINEOVERRIDES =. "sigmaracer-wingman:imx95:"

MACHINE_FEATURES:append = " wifi bluetooth can vulkan"

SIGMARACER_WINGMAN_DISPLAY_WIDTH = "1280"
SIGMARACER_WINGMAN_DISPLAY_HEIGHT = "720"
SIGMARACER_WINGMAN_CAN_IFACE = "can0"
SIGMARACER_WINGMAN_BOOT_PART_SIZE = "128M"

WKS_FILE = "sigmaracer-wingman-ab.wks.in"

# Placeholder until imx95 machine is available in your meta-imx checkout:
# Uncomment and adjust when BSP is integrated:
# require conf/machine/imx95-19x19-lpddr4x-evk.conf
```

## meta-sigmaracer-wingman/conf/machine/sigmaracer-wingman-qemu.conf
```bitbake
# Sigma Sigma Racer Wingman — QEMU x86-64 virtual target for local integration testing
# Same 800×480 cluster layout as sigmaracer-wingman-imx8mp; no NXP BSP required.

require conf/machine/qemux86-64.conf

MACHINE = "sigmaracer-wingman-qemu"
# Use "virt" not "qemu" — PN "qemu" in OVERRIDES triggers fatal pkgvarcheck QA errors.
MACHINEOVERRIDES =. "sigmaracer-wingman:virt:"

MACHINE_FEATURES:append = " wifi"

SIGMARACER_WINGMAN_DISPLAY_WIDTH = "800"
SIGMARACER_WINGMAN_DISPLAY_HEIGHT = "480"

PREFERRED_PROVIDER_virtual/kernel = "linux-yocto"

# ext4 rootfs for runqemu (skip A/B WIC layout used on hardware)
WKS_FILE = ""
IMAGE_FSTYPES:pn-sigmaracer-wingman-image = "ext4"

# No hardware video codecs on the virtual target
IMAGE_FEATURES:remove = " hwcodec"

# QEMU: virtio-gpu for Weston DRM (runqemu reads QB_GRAPHICS, not QB_GRAPHICAL)
QB_MEM = "-m 4096"
QB_SMP = "-smp 4"
QB_GRAPHICS = "-device virtio-gpu-pci"
```
